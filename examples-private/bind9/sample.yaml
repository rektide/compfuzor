## files/hw-ubi/uboot.its
```
/*
 * Simple U-boot uImage source file containing a single kernel and FDT blob
 */

/dts-v1/;

/ {
	description = "iConnect kernel image and FDT blob";
	#address-cells = <1>;

	images {
		kernel@1 {
			description = "Linux kernel";
			data = /incbin/("./vmlinuz");
			type = "kernel";
			arch = "arm";
			os = "linux";
			compression = "none";
			load = <00000000>;
			entry = <00000000>;
			hash@1 {
				algo = "crc32";
			};
			/*
			 * hash@2 {
			 *	algo = "sha1";
			 * };
			 */
		};
		fdt@1 {
			description = "Flattened Device Tree blob";
			data = /incbin/("./kirkwood-iconnect.dtb");
			type = "flat_dt";
			arch = "arm";
			compression = "none";
			hash@1 {
				algo = "crc32";
			};
			/*
			 * hash@2 {
			 *	algo = "sha1";
			 * };
			 */
		};
	};

	configurations {
		default = "conf@1";
		conf@1 {
			description = "Boot Linux kernel with FDT blob";
			kernel = "kernel@1";
			fdt = "fdt@1";
		};
	};
};
```
